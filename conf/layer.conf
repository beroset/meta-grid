## conf/layer.conf
```bitbake
# We have a conf and classes directory, add to BBPATH
BBPATH .= ":${LAYERDIR}"

# We have recipes-* directories, add to BBFILES
BBFILES += "${LAYERDIR}/recipes-*/*/*.bb \
            ${LAYERDIR}/recipes-*/*/*.bbappend"

BBFILE_COLLECTIONS += "meta-grid"
BBFILE_PATTERN_meta-grid = "^${LAYERDIR}/"
BBFILE_PRIORITY_meta-grid = "6"

LAYERDEPENDS_meta-grid = "core"
LAYERSERIES_COMPAT_meta-grid = "scarthgap"
```
